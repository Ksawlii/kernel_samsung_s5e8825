## drivers/gpu/drm/samsung/panel_decon/s6e3fc3/Kconfig
```kconfig
menuconfig EXYNOS_DECON_LCD_S6E3FC3_A33X
	tristate "S6E3FC3 DDI Panel Driver"
	depends on MCD_PANEL
	default n
	help
		This enables S6E3FC3 A33X DDI dependent panel drivers of
		common panel driver. say Y, if you have a panel based on
		the S6E3FC3 DDI.

menuconfig EXYNOS_DECON_LCD_S6E3FC3_A53X
	tristate "S6E3FC3 DDI Panel Driver"
	depends on MCD_PANEL
	default n
	help
		This enables S6E3FC3 A53X DDI dependent panel drivers of
		common panel driver. say Y, if you have a panel based on
		the S6E3FC3 DDI.

menuconfig EXYNOS_DECON_LCD_S6E3FC3_M34X
	tristate "S6E3FC3 DDI Panel Driver"
	depends on MCD_PANEL
	default n
	help
		This enables S6E3FC3 M34X DDI dependent panel drivers of
		common panel driver. say Y, if you have a panel based on
		the S6E3FC3 DDI.
```
